## firmware/esp32_cam/components/wifi_manager/Kconfig
```kconfig
menu "Prometeo Wi-Fi (hotspot de la camara)"

    config PROMETEO_WIFI_SSID
        string "Nombre del hotspot que crea la camara"
        default "prometeo"

    config PROMETEO_WIFI_PASSWORD
        string "Contrasena del hotspot (minimo 8 caracteres, o vacia = red abierta)"
        default "prometeo123"

    config PROMETEO_WIFI_CHANNEL
        int "Canal Wi-Fi (1-13)"
        range 1 13
        default 6

    config PROMETEO_WIFI_MAX_CLIENTES
        int "Maximo de clientes conectados (micro-ROS, la compu, ...)"
        range 1 10
        default 4

    config PROMETEO_WIFI_TX_POWER_DBM
        int "Potencia de transmision del hotspot (dBm)"
        range 2 20
        default 10
        help
            Menos potencia = picos de corriente mas chicos. Con la fuente del robot justa,
            los picos del Wi-Fi bajan la tension y pueden reiniciar la placa. A 10 dBm
            sobra para unos metros; si el cuerpo o la PC estan lejos, subirla (maximo 20).

endmenu
```

## firmware/micro_ros/drivers/encoders/Kconfig.projbuild
```kconfig
# Opciones de la libreria de encoders (encoder.c).
menu "Prometeo - Encoders"

    comment "== Pines =="

    config PROMETEO_ENCODER_DEL_DER_PIN
        int "Encoder rueda delantera derecha - pin"
        range 0 39
        default 5

    config PROMETEO_ENCODER_DEL_IZQ_PIN
        int "Encoder rueda delantera izquierda - pin"
        range 0 39
        default 2

    config PROMETEO_ENCODER_TRAS_DER_PIN
        int "Encoder rueda trasera derecha - pin"
        range 0 39
        default 14

    config PROMETEO_ENCODER_TRAS_IZQ_PIN
        int "Encoder rueda trasera izquierda - pin"
        range 0 39
        default 13

    comment "== Rueda =="

    config PROMETEO_DIAMETRO_RUEDA_MM
        int "Diametro de la rueda (mm)"
        range 10 500
        default 65

    comment "== Misc =="

    config PROMETEO_ENC_FLACOS
        int "Conteo de Flancos por pulso"
        range 1 2
        default 2
        help
            Flancos que se cuentan por pulso: 1 = solo subida, 2 = tambien bajada.
            Con 2 hay el doble de cuentas por vuelta (mas resolucion).
            Puede introducir errores en el conteo.

    config PROMETEO_ENC_FILTRO_TAU_MS
        int "Filtro pasa-bajos de las rpm: constante de tiempo (ms)"
        range 0 2000
        default 300
        help
            encoder_get_rpm() devuelve las rpm pasadas por un filtro de primer orden con esta
            constante de tiempo: llega al 63 % del cambio en tau y baja de 3 rpm unas 3,5 tau
            despues de frenar. 0 = sin filtro. encoder_get_rpm_raw() siempre devuelve la medida cruda.
            Mas tau = curva mas suave pero mas atraso (afecta a los lazos de control que usan la rpm).

    config PROMETEO_ENC_PPR
        int "Numero de ranuras del disco"
        range 0 100
        default 20
        help
            Pulsos por revolucion

endmenu
```

## firmware/micro_ros/drivers/motores/Kconfig.projbuild
```kconfig
# Opciones de la libreria de motores (motores.c). Los pines de los encoders y el diametro de
# la rueda estan en drivers/encoders/Kconfig.projbuild.
menu "Prometeo - Pines de motores"

    comment "======== Placa Motor ========"

    comment "== Delantero Izquierdo (motor A) =="

    config PROMETEO_MOTOR_A1_PIN
        int "Motor A (delantero izquierdo) - pin IA"
        range 0 33
        default 21

    config PROMETEO_MOTOR_A2_PIN
        int "Motor A (delantero izquierdo) - pin IB"
        range 0 33
        default 22

    comment "== Trasero Izquierdo (motor B) =="

    config PROMETEO_MOTOR_B1_PIN
        int "Motor B (trasero izquierdo) - pin IA"
        range 0 33
        default 16

    config PROMETEO_MOTOR_B2_PIN
        int "Motor B (trasero izquierdo) - pin IB"
        range 0 33
        default 23

    comment "== Delantero Derecho (motor C) =="

    config PROMETEO_MOTOR_C1_PIN
        int "Motor C (delantero derecho) - pin IA"
        range 0 33
        default 18

    config PROMETEO_MOTOR_C2_PIN
        int "Motor C (delantero derecho) - pin IB"
        range 0 33
        default 19

    comment "== Trasero Derecho (motor D) =="

    config PROMETEO_MOTOR_D1_PIN
        int "Motor D (trasero derecho) - pin IA"
        range 0 33
        default 17

    config PROMETEO_MOTOR_D2_PIN
        int "Motor D (trasero derecho) - pin IB"
        range 0 33
        default 25

endmenu

menu "Prometeo - PWM"

    config PROMETEO_PWM_FREQ_HZ
        int "Frecuencia del PWM (Hz)"
        range 100 20000
        default 10000
        help
            Frecuencia del PWM de los motores. Mas alta = mas silencioso, pero menos torque.
            Mas baja = mas torque, pero mas ruido y vibracion. Ajustar segun el driver de potencia.

    config PROMETEO_PWM_RES_BIT
        int "Resolucion del PWM (bits)"
        range 1 16
        default 10
        help
            Resolucion del PWM de los motores. Mas bits = mas preciso, pero menos torque.

endmenu

menu "Prometeo - Cinematica"

    config PROMETEO_RAMP_TIME_MS
        int "Tiempo de rampa de velocidad (ms)"
        range 0 10000
        default 1000
        help
            Tiempo de rampa de velocidad (ms). Al llamar a la funcion aplicar() este es el tiempo que tarda en llegar a la velocidad objetivo.

    config PROMETEO_RAMP_STEP
        int "Step de rampa de velocidad (0 a 2^PWM_RES_BIT - 1 )"
        range 0 255
        default 40
        help
            Step maximo de rampa de velocidad (0 a 2^PWM_RES_BIT - 1 ).
            Al llamar a la funcion aplicar() este es el maximo cambio permitido.

endmenu
```

## firmware/micro_ros/logica/Kconfig.projbuild
```kconfig
menu "Prometeo - Centrado en el pasillo"

    config PROMETEO_CENTRADO
        bool "Centrar el robot en el pasillo (PID con los ultrasonidos laterales)"
        default y
        help
            Al avanzar por /cmd_vel sin que nadie pida girar, suma una velocidad angular que
            mantiene al robot en el medio del pasillo (izquierda = derecha). Si un costado no
            ve pared (una salida) o no hay dato, no corrige. Si la compu tambien centra
            (panel.launch.py asistencia:=true), apagar uno de los dos: se pisarian.

    config PROMETEO_PASILLO_ANCHO_MM
        int "Ancho del pasillo (mm)"
        depends on PROMETEO_CENTRADO
        range 200 1000
        default 400
        help
            Se usa para normalizar el error: media distancia entre paredes = error 1.

    config PROMETEO_CENTRADO_PARED_MAX_MM
        int "Distancia maxima a una pared lateral (mm)"
        depends on PROMETEO_CENTRADO
        range 200 1000
        default 500
        help
            Un costado que mide mas que esto (o no ve nada) es una salida: no se corrige.

    config PROMETEO_CENTRADO_VEL_MIN_MM_S
        int "Avance minimo para centrar (mm/s)"
        depends on PROMETEO_CENTRADO
        range 10 500
        default 50
        help
            Con menos avance (parado, girando en el lugar) el centrado no actua.

    config PROMETEO_CENTRADO_KP_X100
        int "Ganancia proporcional (x100)"
        depends on PROMETEO_CENTRADO
        range 0 1000
        default 100
        help
            100 = 1,0 rad/s con el robot pegado a una pared (error 1). Subir si tarda en
            centrarse; si zigzaguea, bajar.

    config PROMETEO_CENTRADO_KI_X100
        int "Ganancia integral (x100)"
        depends on PROMETEO_CENTRADO
        range 0 1000
        default 0
        help
            Corrige un desvio constante (un lado del robot que tira mas). 0 = sin I.

    config PROMETEO_CENTRADO_KD_X100
        int "Ganancia derivativa (x100)"
        depends on PROMETEO_CENTRADO
        range 0 1000
        default 150
        help
            Amortigua el zigzag: sin D el robot oscila alrededor del medio. Si vibra, bajar.

    config PROMETEO_CENTRADO_W_MAX_X100
        int "Correccion maxima de giro (rad/s x100)"
        depends on PROMETEO_CENTRADO
        range 5 200
        default 40
        help
            Tope de la velocidad angular que suma el centrado (40 = 0,4 rad/s).

endmenu
```

## firmware/micro_ros/main/Kconfig.projbuild
```kconfig
menu "Prometeo - Pines de la camara"

    config PROMETEO_CAMARA_UART_TX_PIN
        int "Camara UART - pin TX"
        range 0 33
        default 1

    config PROMETEO_CAMARA_UART_RX_PIN
        int "Camara UART - pin RX"
        range 0 33
        default 3

endmenu

menu "Prometeo - Busqueda del agente micro-ROS"

    config PROMETEO_AGENTE_AUTO
        bool "Buscar el agente en la red (sin conocer su IP)"
        default y
        help
            Si el agente no responde en MICRO_ROS_AGENT_IP, recorre las direcciones de la
            red /24 de la ESP32 probando el puerto del agente, y usa la primera que
            responde. Al perder el agente vuelve a buscar (la IP de la compu puede cambiar
            al reconectarse al hotspot de la camara).

    config PROMETEO_AGENTE_PING_MS
        int "Espera por direccion al buscar (ms)"
        depends on PROMETEO_AGENTE_AUTO
        range 20 500
        default 60
        help
            Tiempo que se espera la respuesta de cada IP en la barrida completa (cada intento
            real tarda ~2 veces este valor). En las primeras IP se espera el triple.

    config PROMETEO_AGENTE_HOSTS_RAPIDOS
        int "Cantidad de IP a probar primero (desde .2)"
        depends on PROMETEO_AGENTE_AUTO
        range 1 50
        default 8
        help
            El DHCP de la camara reparte las IP en orden desde .2, asi que la compu y el
            cuerpo estan en las primeras. Se prueban estas en cada intento (rapido).

    config PROMETEO_AGENTE_BARRIDO_CADA
        int "Cada cuantos intentos hacer la barrida completa de la red"
        depends on PROMETEO_AGENTE_AUTO
        range 1 100
        default 6
        help
            Si el agente no esta entre las primeras IP, se recorre el resto de la red /24
            (lento, ~25 s) cada tantos intentos.

endmenu

menu "Prometeo - Test de motores"

    config PROMETEO_BUILD_MOTOR_TEST
        bool "Compilar el firmware de TEST DE MOTORES (en vez del normal)"
        default n
        help
            Compila main/main_test_motores.c: recorre los 4 motores (adelante y atras),
            publica su estado por micro-ROS y acepta comandos. No inicia servos ni
            sensores. Para volver al firmware normal, desactivar esta opcion.

    config PROMETEO_TEST_AUTOSTART
        bool "Arrancar el ciclo solo, unos segundos despues de iniciar"
        depends on PROMETEO_BUILD_MOTOR_TEST
        default n
        help
            Si esta desactivado el test arranca en pausa y espera el comando "auto".

    config PROMETEO_TEST_AUTOSTART_DELAY_S
        int "Segundos de espera antes de arrancar solo"
        depends on PROMETEO_TEST_AUTOSTART
        range 1 60
        default 10

    config PROMETEO_TEST_DUTY_MAX_PCT
        int "Potencia maxima del test (%)"
        depends on PROMETEO_BUILD_MOTOR_TEST
        range 10 100
        default 60

    config PROMETEO_TEST_RAMP_MS
        int "Duracion de la subida de potencia (ms)"
        depends on PROMETEO_BUILD_MOTOR_TEST
        range 200 10000
        default 1500

    config PROMETEO_TEST_HOLD_MS
        int "Tiempo a potencia maxima (ms)"
        depends on PROMETEO_BUILD_MOTOR_TEST
        range 100 10000
        default 800

    config PROMETEO_TEST_PAUSE_MS
        int "Pausa entre pasos (ms)"
        depends on PROMETEO_BUILD_MOTOR_TEST
        range 100 10000
        default 700

endmenu
```
