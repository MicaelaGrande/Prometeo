## firmware/esp32_cam/components/wifi_manager/Kconfig
```kconfig
menu "Prometeo Wi-Fi"

    config PROMETEO_WIFI_SSID
        string "Nombre de la red Wi-Fi"
        default ""

    config PROMETEO_WIFI_PASSWORD
        string "Contrasena de la red Wi-Fi"
        default ""

endmenu
```

## micro_ros/drivers/Kconfig.projbuild
```kconfig
menu "Prometeo - Pines GPIO"

    comment "======== Concentrador Delantero ========"

    comment "== Sensores HC-SR04 =="

    config PROMETEO_SENSOR_TRIG_PIN
        int "Sensores (izq, der, frente) - pin TRIG compartido"
        range 0 33
        default 4

    config PROMETEO_SENSOR_IZQ_ECHO_PIN
        int "Sensor izquierdo - pin ECHO"
        range 0 39
        default 34

    config PROMETEO_SENSOR_DER_ECHO_PIN
        int "Sensor derecho - pin ECHO"
        range 0 39
        default 32

    config PROMETEO_SENSOR_FRENTE_ECHO_PIN
        int "Sensor frontal - pin ECHO"
        range 0 39
        default 35

    comment "== Encoders =="

    config PROMETEO_ENCODER_DEL_DER_PIN
        int "Encoder rueda delantera derecha - pin"
        range 0 39
        default 5

    config PROMETEO_ENCODER_DEL_IZQ_PIN
        int "Encoder rueda delantera izquierda - pin"
        range 0 39
        default 2

    config PROMETEO_ENCODER_TRAS_DER_PIN
        int "Encoder rueda trasera derecha - pin"
        range 0 39
        default 14

    config PROMETEO_ENCODER_TRAS_IZQ_PIN
        int "Encoder rueda trasera izquierda - pin"
        range 0 39
        default 13

    comment "======== Control Brazo ========"

    config PROMETEO_SERVO_1_PIN
        int "Servo 1 (camara) - pin"
        range 0 33
        default 0

    config PROMETEO_SERVO_2_PIN
        int "Servo 2 (base) - pin"
        range 0 33
        default 33

    config PROMETEO_SERVO_3_PIN
        int "Servo 3 (hombro) - pin"
        range 0 33
        default 26

    config PROMETEO_SERVO_4_PIN
        int "Servo 4 (codo) - pin"
        range 0 33
        default 27

    config PROMETEO_SERVO_5_PIN
        int "Servo 5 (garra) - pin"
        range 0 33
        default 12

    comment "======== Camara ========"

    config PROMETEO_CAMARA_UART_TX_PIN
        int "Camara UART - pin TX"
        range 0 33
        default 1

    config PROMETEO_CAMARA_UART_RX_PIN
        int "Camara UART - pin RX"
        range 0 33
        default 3

    comment "======== Placa Motor ========"

    comment "== Delantero Izquierdo (motor A) =="

    config PROMETEO_MOTOR_A1_PIN
        int "Motor A (delantero izquierdo) - pin IA"
        range 0 33
        default 21

    config PROMETEO_MOTOR_A2_PIN
        int "Motor A (delantero izquierdo) - pin IB"
        range 0 33
        default 22

    comment "== Trasero Izquierdo (motor B) =="

    config PROMETEO_MOTOR_B1_PIN
        int "Motor B (trasero izquierdo) - pin IA"
        range 0 33
        default 16

    config PROMETEO_MOTOR_B2_PIN
        int "Motor B (trasero izquierdo) - pin IB"
        range 0 33
        default 23

    comment "== Delantero Derecho (motor C) =="

    config PROMETEO_MOTOR_C1_PIN
        int "Motor C (delantero derecho) - pin IA"
        range 0 33
        default 18

    config PROMETEO_MOTOR_C2_PIN
        int "Motor C (delantero derecho) - pin IB"
        range 0 33
        default 19

    comment "== Trasero Derecho (motor D) =="

    config PROMETEO_MOTOR_D1_PIN
        int "Motor D (trasero derecho) - pin IA"
        range 0 33
        default 17

    config PROMETEO_MOTOR_D2_PIN
        int "Motor D (trasero derecho) - pin IB"
        range 0 33
        default 25

endmenu

menu "Prometeo - Cinematica"

    config PROMETEO_WHEEL_SEPARATION_MM
        int "Separacion entre ruedas izq/der (mm)"
        range 50 1000
        default 135
        help
            Distancia entre el centro de las ruedas izquierdas y derechas
            (URDF: wheel_separation = 0.1605 m).

    config PROMETEO_VEL_MAX_MM_S
        int "Velocidad lineal con motores al 100% (mm/s)"
        range 50 5000
        default 700
        help
            Velocidad del robot en linea recta a duty 1.0. ESTIMADO: medir
            cronometrando cuanto tarda en recorrer 1 m a fondo.
            Tambien la usa el freno de emergencia (seguridad.c).

    config PROMETEO_TURN_FACTOR_PCT
        int "Factor de giro skid-steer (%)"
        range 50 500
        default 100
        help
            Multiplica la separacion entre ruedas para girar. Con 4 ruedas sin
            direccion las ruedas patinan al girar y el ancho efectivo es mayor
            que el real (tipico 150-250%). Ajustar girando en el lugar a una
            velocidad angular conocida: si gira de menos, bajar el factor.

    config PROMETEO_MOTORES_SPEED_LOOP
        bool "Mantener la velocidad de cada rueda con su encoder (PID)"
        default y
        help
            Solo para ordenes de motores_set_twist() / motores_set_ruedas() (/cmd_vel). Cada
            rueda se mide con su encoder y su motor sube o baja el duty hasta girar a la
            velocidad pedida, asi las 4 ruedas giran igual. Requiere encoders.

    config PROMETEO_TURN_BOOST_PCT
        int "Refuerzo de duty al girar (%)"
        range 0 200
        default 30
        help
            Al girar la velocidad angular pedida se multiplica por 1 + este valor: mas duty en las 4 ruedas
            para vencer el patinaje. 0 = sin refuerzo. El giro real sale mas rapido que el pedido.

    config PROMETEO_TURN_MIN_DUTY_PCT
        int "Duty minimo al girar (%)"
        range 0 100
        default 70
        help
            Al girar, el lado mas rapido recibe al menos este duty (el otro en proporcion, para
            conservar el radio de giro). Las 4 ruedas patinan y con un giro lento el duty
            que sale de cmd_vel no alcanza para moverlas. 0 = sin minimo. Subir si no gira,
            bajar si gira demasiado rapido.

    config PROMETEO_MOTORES_SPEED_WINDOW_MS
        int "Ventana de medicion de velocidad del lazo (ms)"
        depends on PROMETEO_MOTORES_SPEED_LOOP
        range 200 3000
        default 500
        help
            Un pulso en 500 ms de UNA rueda son ~0,02 m/s. Mas ventana = mas preciso pero mas
            lento para corregir.

    config PROMETEO_MOTORES_SPEED_KP_X100
        int "Ganancia proporcional del lazo (x100)"
        depends on PROMETEO_MOTORES_SPEED_LOOP
        range 0 1000
        default 30
        help
            100 = 1,0: un error igual a VEL_MAX suma 1,0 de duty. Se aplica una vez por ventana
            y se mantiene hasta la siguiente medicion. 0 = sin P.

    config PROMETEO_MOTORES_SPEED_KI_X100
        int "Ganancia integral del lazo (x100)"
        depends on PROMETEO_MOTORES_SPEED_LOOP
        range 1 1000
        default 100
        help
            100 = 1,0: por cada segundo con un error igual a VEL_MAX, sube 1,0 de duty.
            Subirla corrige mas rapido pero puede oscilar.

    config PROMETEO_MOTORES_SPEED_KD_X100
        int "Ganancia derivativa del lazo (x100)"
        depends on PROMETEO_MOTORES_SPEED_LOOP
        range 0 1000
        default 0
        help
            Frena la correccion cuando el error baja rapido. Con la resolucion de los encoders
            (1 pulso por ventana) la derivada es muy ruidosa: dejar en 0 salvo que se mida bien.

    config PROMETEO_MOTORES_SPEED_BOOST_MAX_PCT
        int "Refuerzo maximo de duty (%)"
        depends on PROMETEO_MOTORES_SPEED_LOOP
        range 0 100
        default 50
        help
            Tope de la correccion total (P+I+D) que puede sumar el lazo, para que un encoder roto o una
            VEL_MAX mal estimada no lleven los motores al maximo.

    config PROMETEO_MOTORES_SPEED_REDUCE_MAX_PCT
        int "Reduccion maxima de duty de una rueda rapida (%)"
        depends on PROMETEO_MOTORES_SPEED_LOOP
        range 0 100
        default 30
        help
            Cuanto puede bajar el lazo el duty de una rueda que gira mas rapido que la pedida,
            para igualarla con las demas. La zona muerta de motores.c sigue poniendo el minimo.

endmenu

menu "Prometeo - Centrado en el pasillo"

    config PROMETEO_CENTRADO
        bool "Centrar el robot en el pasillo (PID con los ultrasonidos laterales)"
        default y
        help
            Al avanzar por /cmd_vel sin que nadie pida girar, suma una velocidad angular que
            mantiene al robot en el medio del pasillo (izquierda = derecha). Si un costado no
            ve pared (una salida) o no hay dato, no corrige. Si la compu tambien centra
            (panel.launch.py asistencia:=true), apagar uno de los dos: se pisarian.

    config PROMETEO_PASILLO_ANCHO_MM
        int "Ancho del pasillo (mm)"
        depends on PROMETEO_CENTRADO
        range 200 1000
        default 400
        help
            Se usa para normalizar el error: media distancia entre paredes = error 1.

    config PROMETEO_CENTRADO_PARED_MAX_MM
        int "Distancia maxima a una pared lateral (mm)"
        depends on PROMETEO_CENTRADO
        range 200 1000
        default 500
        help
            Un costado que mide mas que esto (o no ve nada) es una salida: no se corrige.

    config PROMETEO_CENTRADO_VEL_MIN_MM_S
        int "Avance minimo para centrar (mm/s)"
        depends on PROMETEO_CENTRADO
        range 10 500
        default 50
        help
            Con menos avance (parado, girando en el lugar) el centrado no actua.

    config PROMETEO_CENTRADO_KP_X100
        int "Ganancia proporcional (x100)"
        depends on PROMETEO_CENTRADO
        range 0 1000
        default 100
        help
            100 = 1,0 rad/s con el robot pegado a una pared (error 1). Subir si tarda en
            centrarse; si zigzaguea, bajar.

    config PROMETEO_CENTRADO_KI_X100
        int "Ganancia integral (x100)"
        depends on PROMETEO_CENTRADO
        range 0 1000
        default 0
        help
            Corrige un desvio constante (un lado del robot que tira mas). 0 = sin I.

    config PROMETEO_CENTRADO_KD_X100
        int "Ganancia derivativa (x100)"
        depends on PROMETEO_CENTRADO
        range 0 1000
        default 150
        help
            Amortigua el zigzag: sin D el robot oscila alrededor del medio. Si vibra, bajar.

    config PROMETEO_CENTRADO_W_MAX_X100
        int "Correccion maxima de giro (rad/s x100)"
        depends on PROMETEO_CENTRADO
        range 5 200
        default 40
        help
            Tope de la velocidad angular que suma el centrado (40 = 0,4 rad/s).

endmenu

menu "Prometeo - Test de motores"

    config PROMETEO_BUILD_MOTOR_TEST
        bool "Compilar el firmware de TEST DE MOTORES (en vez del normal)"
        default n
        help
            Compila main/main_test_motores.c: recorre los 4 motores (adelante y atras),
            publica su estado por micro-ROS y acepta comandos. No inicia servos ni
            sensores. Para volver al firmware normal, desactivar esta opcion.

    config PROMETEO_TEST_AUTOSTART
        bool "Arrancar el ciclo solo, unos segundos despues de iniciar"
        depends on PROMETEO_BUILD_MOTOR_TEST
        default n
        help
            Si esta desactivado el test arranca en pausa y espera el comando "auto".

    config PROMETEO_TEST_AUTOSTART_DELAY_S
        int "Segundos de espera antes de arrancar solo"
        depends on PROMETEO_TEST_AUTOSTART
        range 1 60
        default 10

    config PROMETEO_TEST_DUTY_MAX_PCT
        int "Potencia maxima del test (%)"
        depends on PROMETEO_BUILD_MOTOR_TEST
        range 10 100
        default 60

    config PROMETEO_TEST_RAMP_MS
        int "Duracion de la subida de potencia (ms)"
        depends on PROMETEO_BUILD_MOTOR_TEST
        range 200 10000
        default 1500

    config PROMETEO_TEST_HOLD_MS
        int "Tiempo a potencia maxima (ms)"
        depends on PROMETEO_BUILD_MOTOR_TEST
        range 100 10000
        default 800

    config PROMETEO_TEST_PAUSE_MS
        int "Pausa entre pasos (ms)"
        depends on PROMETEO_BUILD_MOTOR_TEST
        range 100 10000
        default 700

endmenu

menu "Prometeo - Seguridad motores"

    config PROMETEO_MOTORES_STOP_ALL
        bool "Un atasco o sobreesfuerzo frena los 4 motores"
        default y
        help
            Aplica a motores.c. Si esta desactivado, solo se frena el motor atascado
            o el puente sobrecargado. La falla queda latcheada hasta motores_liberar_fallas().

    config PROMETEO_MOTORES_STALL_ENABLE
        bool "Detectar rueda que no gira (velocidad minima del encoder)"
        default n
        help
            Requiere encoders_init() antes de motores_init(). Desactivar si el firmware
            no usa encoders.
            APAGADO POR DEFECTO (acordado el 6/11/2026): los encoders todavia no son
            confiables, y un encoder que no cuenta parece una rueda trabada: frenaria los
            4 motores en medio de la ronda. Prenderlo recien con los encoders probados.

    config PROMETEO_MOTORES_STALL_DUTY_MIN_PCT
        int "Duty desde el cual se vigila el atasco (%)"
        depends on PROMETEO_MOTORES_STALL_ENABLE
        range 0 100
        default 70

    config PROMETEO_MOTORES_STALL_WINDOW_MS
        int "Ventana de medicion de velocidad (ms)"
        depends on PROMETEO_MOTORES_STALL_ENABLE
        range 100 10000
        default 1500

    config PROMETEO_MOTORES_STALL_MIN_PPS
        int "Velocidad minima del encoder con el motor andando (pulsos/s)"
        depends on PROMETEO_MOTORES_STALL_ENABLE
        range 0 1000
        default 2
        help
            20 pulsos = 1 vuelta, asi que 2 pulsos/s = 6 rpm. 0 = solo se falla si no hay
            ningun pulso en la ventana. La resolucion es 1 pulso por ventana (0,67 pulsos/s
            con 1,5 s). Medir la velocidad real con carga y dejar margen.

    config PROMETEO_MOTORES_EFFORT_ENABLE
        bool "Vigilar el esfuerzo de cada puente H (proteccion termica)"
        default y

    config PROMETEO_MOTORES_EFFORT_LIMIT_PCT
        int "Limite de esfuerzo medio por puente (%)"
        depends on PROMETEO_MOTORES_EFFORT_ENABLE
        range 5 200
        default 150
        help
            Sin sensor de corriente: se estima como duty^2 de los dos motores del puente,
            promediado con la constante de tiempo. 100 = un motor a duty 1 sostenido
            (o los dos a 0,71); el maximo es 200. Ajustar mirando la temperatura del driver.

    config PROMETEO_MOTORES_EFFORT_TAU_S
        int "Constante de tiempo del esfuerzo (s)"
        range 1 600
        default 10

endmenu
```
